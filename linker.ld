/* =========================================================================
 * Project NEXUS
 * Linker script for Raspberry Pi 3 (AArch64, bare-metal)
 * ========================================================================= */

ENTRY(_start)

SECTIONS
{
    /* -------------------------------------------------------------
     * Kernel load address
     * The Pi firmware loads kernel8.img at 0x80000
     * ------------------------------------------------------------- */
    . = 0x00080000;

    /* -------------------- TEXT (code) ---------------------------- */
    .text : ALIGN(4K)
    {
        KEEP(*(.text._start))   /* ensure entry point is kept */
        *(.text*)
    }

    /* -------------------- RODATA --------------------------------- */
    .rodata : ALIGN(4K)
    {
        *(.rodata*)
    }

    /* -------------------- DATA ----------------------------------- */
    .data : ALIGN(4K)
    {
        *(.data*)
    }

    /* -------------------- BSS ------------------------------------ */
    .bss : ALIGN(4K)
    {
        __bss_start = .;
        *(.bss*)
        *(COMMON)
        __bss_end = .;
    }

    /* -------------------------------------------------------------
     * End of kernel image
     * ------------------------------------------------------------- */
    __kernel_end = .;
}

/* -------------------------------------------------------------
 * Stack (defined symbol only, no memory reserved here)
 * Stack grows DOWN from this address
 * ------------------------------------------------------------- */
PROVIDE(_stack_top = 0x04000000);
